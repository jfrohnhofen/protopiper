#include "Dynamixel.h"

const uint8_t Dynamixel::param_lengths[] = {
  2, 1, 2, 2, 2, 1, 1, 1, 1, 1,
  1, 1, 1, 2, 2, 1, 1, 1, 1, 2,
  1, 1, 1, 1, 1, 1, 1, 2, 2, 2, 2
};

const uint8_t Dynamixel::param_offsets[] = {
  0, 2, 37, 39, 41, 45, 46, 47, 49, 50,
  3, 4, 5, 6, 8, 11, 12, 13, 14, 15,
  17, 18, 24, 25, 27, 28, 29, 30, 32, 35, 51
};

const uint32_t Dynamixel::baud_rates[] = {9600, 57600, 115200, 1000000};

const uint16_t Dynamixel::crc_table[256] = {
  0x0000, 0x8005, 0x800F, 0x000A, 0x801B, 0x001E, 0x0014, 0x8011,
  0x8033, 0x0036, 0x003C, 0x8039, 0x0028, 0x802D, 0x8027, 0x0022,
  0x8063, 0x0066, 0x006C, 0x8069, 0x0078, 0x807D, 0x8077, 0x0072,
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  0x8213, 0x0216, 0x021C, 0x8219, 0x0208, 0x820D, 0x8207, 0x0202
};

Dynamixel::message_t Dynamixel::msg;

Dynamixel::Dynamixel(uint8_t id, uint8_t direction_pin, uint8_t baud_rate) :
  _id(id),
  _direction_pin(direction_pin),
  _baud_rate(baud_rate),
  _last_error(0)
{
  pinMode(_direction_pin, OUTPUT);
  digitalWrite(_direction_pin, HIGH);
}

bool Dynamixel::reboot()
{
  msg.instruction = REBOOT;
  msg.length = 0;

  write_msg();
  return read_msg();
}

bool Dynamixel::reset()
{
  msg.instruction = RESET;
  msg.length = 0;

  write_msg();
  return read_msg();
}

bool Dynamixel::ping()
{
  msg.instruction = PING;
  msg.length = 0;

  write_msg();
  return read_msg();
}

uint16_t Dynamixel::read(param_t param)
{
  msg.instruction = READ;
  msg.length = 4;
  msg.param = param_offsets[param];
  msg.read_len = param_lengths[param];

  write_msg();
  return read_msg() ? msg.read_value : -1;
}

bool Dynamixel::write(param_t param, uint16_t value)
{
  if(param < ID || param > PUNCH) {
    return false;
  }

  msg.instruction = WRITE;
  msg.length = param_lengths[param] + 2;
  msg.param = param_offsets[param];
  msg.write_value = value;

  write_msg();
  return read_msg();
}

uint8_t Dynamixel::last_error()
{
  return _last_error;
}

uint16_t Dynamixel::calculate_crc()
{
  uint16_t crc = 0;

  for(uint16_t i = 0; i < msg.length + 5; i++) {
    crc = (crc << 8) ^ crc_table[(crc >> 8) ^ msg.data[i]];
  }

  return crc;
}

void Dynamixel::write_msg()
{
  msg.signature = signature;
  msg.id = _id;
  msg.length += 3;

  uint16_t crc = calculate_crc();
  msg.data[msg.length + 5] = crc;
  msg.data[msg.length + 6] = crc >> 8;

  Serial.begin(baud_rates[_baud_rate]);
  while(!Serial);
  Serial.write(msg.data, msg.length + 7);

  //waiting for sending out the command and switching the communication line back to receive\
  //100microsecond is set up for the 1MBs baudrate, for other it needs to be calibrated!!!!!
  delayMicroseconds(100); 
}

bool Dynamixel::read_msg()
{
  while(Serial.available()) {
    Serial.read();
  }

  digitalWrite(_direction_pin, LOW);
  delay(10);
  digitalWrite(_direction_pin, HIGH);

  while(Serial.available() && !Serial.peek()) {
    Serial.read();
  }

  uint8_t read = Serial.readBytes(&msg.data[0], Serial.available() <= sizeof(message_t) ? Serial.available() : sizeof(message_t));
  uint16_t crc = calculate_crc();
  _last_error = msg.error & 0x7F;

  return 
    (read > 10) &&
    (msg.signature == signature) &&
    (msg.id == _id) &&
    (msg.instruction == STATUS) &&
    (msg.data[msg.length + 5] == (crc & 0xFF)) &&
    (msg.data[msg.length + 6] == (crc >> 8)) &&
    ((msg.error & 0x7F) == 0);
}
